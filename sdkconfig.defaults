## sdkconfig.defaults
```kconfig
# USB host: Quectel multi-config modems (ECM often in configuration 2)
CONFIG_USB_HOST_ENABLE_ENUM_FILTER_CALLBACK=y
CONFIG_USB_HOST_HUBS_SUPPORTED=y
CONFIG_USB_HOST_CONTROL_TRANSFER_MAX_SIZE=512
```
